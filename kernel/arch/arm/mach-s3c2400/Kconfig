## kernel/arch/arm/mach-s5p6442/Kconfig
```kconfig
if ARCH_S5P6442

config CPU_S5P6442
	bool
	select PLAT_S5P
	select S3C_PL330_DMA
	help
	  Enable S5P6442 CPU support

config MACH_SMDK6442
	bool "SMDK6442"
	select CPU_S5P6442
	help
	  Machine support for Samsung SMDK6442

endif
```

## kernel/arch/arm/plat-nomadik/Kconfig
```kconfig
config PLAT_NOMADIK
	bool
	depends on ARCH_NOMADIK || ARCH_U8500
	default y
	help
	  Common platform code for Nomadik and other ST-Ericsson
	  platforms.

if PLAT_NOMADIK

config HAS_MTU
	bool
	help
	  Support for Multi Timer Unit. MTU provides access
	  to multiple interrupt generating programmable
	  32-bit free running decrementing counters.

config NOMADIK_GPIO
	bool
	help
	  Support for the Nomadik GPIO controller.

endif
```

## kernel/arch/powerpc/sysdev/Kconfig
```kconfig
config PPC4xx_PCI_EXPRESS
	bool
	depends on PCI && 4xx
	default n

config PPC_MSI_BITMAP
	bool
	depends on PCI_MSI
	default y if MPIC
	default y if FSL_PCI
```

## kernel/drivers/scsi/aic94xx/Kconfig
```kconfig
config SCSI_AIC94XX
	tristate "Adaptec AIC94xx SAS/SATA support"
	depends on PCI
	select SCSI_SAS_LIBSAS
	select FW_LOADER
	help
		This driver supports Adaptec's SAS/SATA 3Gb/s 64 bit PCI-X
		AIC94xx chip based host adapters.

config AIC94XX_DEBUG
	bool "Compile in debug mode"
	default y
	depends on SCSI_AIC94XX
	help
		Compiles the aic94xx driver in debug mode.  In debug mode,
		the driver prints some messages to the console.
```

## kernel/drivers/scsi/libsas/Kconfig
```kconfig
config SCSI_SAS_LIBSAS
	tristate "SAS Domain Transport Attributes"
	depends on SCSI
	select SCSI_SAS_ATTRS
	help
	  This provides transport specific helpers for SAS drivers which
	  use the domain device construct (like the aic94xxx).

config SCSI_SAS_ATA
	bool "ATA support for libsas (requires libata)"
	depends on SCSI_SAS_LIBSAS
	depends on ATA = y || ATA = SCSI_SAS_LIBSAS
	help
		Builds in ATA support into libsas.  Will necessitate
		the loading of libata along with libsas.

config SCSI_SAS_HOST_SMP
	bool "Support for SMP interpretation for SAS hosts"
	default y
	depends on SCSI_SAS_LIBSAS
	help
		Allows sas hosts to receive SMP frames.  Selecting this
		option builds an SMP interpreter into libsas.  Say
		N here if you want to save the few kb this consumes.

config SCSI_SAS_LIBSAS_DEBUG
	bool "Compile the SAS Domain Transport Attributes in debug mode"
	default y
	depends on SCSI_SAS_LIBSAS
	help
		Compiles the SAS Layer in debug mode.  In debug mode, the
		SAS Layer prints diagnostic and debug messages.
```

## kernel/drivers/scsi/mpt2sas/Kconfig
```kconfig
config SCSI_MPT2SAS
	tristate "LSI MPT Fusion SAS 2.0 Device Driver"
	depends on PCI && SCSI
	select SCSI_SAS_ATTRS
	select RAID_ATTRS
	---help---
	This driver supports PCI-Express SAS 6Gb/s Host Adapters.

config SCSI_MPT2SAS_MAX_SGE
	int "LSI MPT Fusion Max number of SG Entries (16 - 128)"
	depends on PCI && SCSI && SCSI_MPT2SAS
	default "128"
	range 16 128
	---help---
	This option allows you to specify the maximum number of scatter-
	gather entries per I/O. The driver default is 128, which matches
	SAFE_PHYS_SEGMENTS.  However, it may decreased down to 16.
	Decreasing this parameter will reduce memory requirements
	on a per controller instance.

config SCSI_MPT2SAS_LOGGING
	bool "LSI MPT Fusion logging facility"
	depends on PCI && SCSI && SCSI_MPT2SAS
	---help---
	This turns on a logging facility.
```

## kernel/drivers/scsi/mvsas/Kconfig
```kconfig
config SCSI_MVSAS
	tristate "Marvell 88SE64XX/88SE94XX SAS/SATA support"
	depends on PCI
	select SCSI_SAS_LIBSAS
	select FW_LOADER
	help
		This driver supports Marvell's SAS/SATA 3Gb/s PCI-E 88SE64XX and 6Gb/s
		PCI-E 88SE94XX chip based host adapters.

config SCSI_MVSAS_DEBUG
	bool "Compile in debug mode"
	default y
	depends on SCSI_MVSAS
	help
		Compiles the 88SE64XX/88SE94XX driver in debug mode.  In debug mode,
		the driver prints some messages to the console.
```
